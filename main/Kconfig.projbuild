## main/Kconfig.projbuild
```kconfig
menu "App Configuration"

    config EXAMPLE_BOARD_BUTTON_GPIO
        int "Boot Button GPIO"
        default 9 if IDF_TARGET_ESP32C3 || IDF_TARGET_ESP32C6 || IDF_TARGET_ESP32C2
        default 0
        help
            GPIO number on which the "Boot" button is connected. This is generally used
            by the application for custom operations like toggling states, resetting to defaults, etc.

    config EXAMPLE_ENABLE_TEST_NOTIFICATIONS
        bool "Test Notifications"
        default n
        help
            Enable this option to test mobile push notifications. When enabled, turning on the switch using
            push button will trigger a parameter notification {"Switch":{"Power":true}} and turning off will
            trigger an alert "Switch was turned off".

    config EXAMPLE_OUTPUT_GPIO
        int "Output GPIO"
        default 19
        help
            This is an output GPIO that will be connected to a relay or other driver circuit in most cases.
            If the power changes, this GPIO output level will also change.

    menu "Task configuration"


        config APP_TASK
            int "Memory dedicated to App task"
            default 4096
            help
                Memory dedicated to executed the App task
            
        config RESOURCE_EVENT_TASK
            int "Memory dedicated to event task"
            default 3072
            help
                Memory dedicated to executed the event task
    
    endmenu

    menu "Menu Config spi rc522"

        config RC522_SPI_BUS_GPIO_MISO
            int "RC522_SPI_BUS_GPIO_MISO"
            default 25
            help 
                gpio to miso

        config RC522_SPI_BUS_GPIO_MOSI
            int "RC522_SPI_BUS_GPIO_MOSI"
            default 23
            help 
                gpio to mosi

        config RC522_SPI_BUS_GPIO_SCLK
            int "RC522_SPI_BUS_GPIO_SCLK"
            default 19
            help 
                gpio to sclk

        config RC522_SPI_SCANNER_GPIO_SDA
            int "RC522_SPI_SCANNER_GPIO_SDA"
            default 22
            help 
                gpio to sda

        config RC522_SCANNER_GPIO_RST
            int "RC522_SCANNER_GPIO_RST"
            default -1
            help 
                gpio to rst
        
                                                                            
            

    endmenu





endmenu
```
